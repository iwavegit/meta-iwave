## conf/layer.conf
```bitbake
# We have a conf and classes directory, add to BBPATH
BBPATH .= ":${LAYERDIR}"

# We have recipes-* directories, add to BBFILES
BBFILES += "${LAYERDIR}/recipes-*/*/*.bb \
            ${LAYERDIR}/recipes-*/*/*.bbappend"

BBFILE_COLLECTIONS += "iwave"
BBFILE_PATTERN_iwave = "^${LAYERDIR}/"
BBFILE_PRIORITY_iwave = "9"

LAYERDEPENDS_iwave = "core"
LAYERSERIES_COMPAT_iwave = "warrior zeus"
```

## conf/machine/imx8qm-iwg27m-8gb.conf
```bitbake
#@TYPE: Machine
#@NAME: iWave i.MX 8QM B0 IWG27M 8GB LPDDR4
#@DESCRIPTION: Machine configuration for iWave iW-RainboW-G27M-i.MX8QuadMax SMARC Board
#@MAINTAINER: iWave Systems Technologies Pvt. Ltd.

MACHINEOVERRIDES =. "mx8:mx8qm:"

require conf/machine/include/imx-base.inc
require conf/machine/include/arm/arch-arm64.inc

MACHINE_FEATURES_remove = "qca6174"
MACHINE_FEATURES_append = "pci bcm43455 bcm4356 bcm4359 mrvl8997"

PREFERRED_PROVIDER_virtual/bootloader_mx8 = "u-boot-iwg27m"
PREFERRED_PROVIDER_virtual/kernel_mx8 = "linux-iwg27m"

# Don't include kernels in standard images
RDEPENDS_${KERNEL_PACKAGE_NAME}-base = ""

LOADADDR = ""

# We have to disable SERIAL_CONSOLE due to auto-serial-console
SERIAL_CONSOLES = "115200;ttyAMA0"

# we do not want to have getty running on tty1 as we run
# auto-serial-console there
USE_VT = "0"

# Device tree for i.MX8QM IWG27M
KERNEL_DEVICETREE = "freescale/imx8qm-iwg27m.dtb"

UBOOT_SUFFIX = "bin"
UBOOT_CONFIG ??= "sd"
UBOOT_CONFIG[sd] = "imx8qm_iwg27m_8gb_defconfig,sdcard"

IMAGE_BOOTLOADER = "imx-boot"

WKS_FILE_DEPENDS_append = " firmware-imx-8"
IMAGE_BOOT_FILES += "hdmitxfw.bin hdmirxfw.bin dpfw.bin"

IMAGE_INSTALL_append = " gstreamer1.0-libav obexftp dhcpcd iwtest mrvl-wireless pciutils"
LICENSE_FLAGS_WHITELIST = "commercial"

RDEPENDS_${KERNEL_PACKAGE_NAME}-image_imx8qm-iwg27m-8gb = ""

UBOOT_MAKE_TARGET = "u-boot.bin"

SPL_BINARY = "spl/u-boot-spl.bin"

IMX_BOOT_SEEK = "32"

WKS_FILE_DEPENDS_remove = "firmware-imx-8"

IMXBOOT_TARGETS_SD = "flash_spl"

IMXBOOT_TARGETS = \
    "${@bb.utils.contains('UBOOT_CONFIG',         'sd', '${IMXBOOT_TARGETS_SD}', \
                                                        '', d)}"

BOARD_TYPE = "iwg27m"

# Add additional firmware
MACHINE_FIRMWARE_append = " linux-firmware-ath10k"
```
